## app/ai_butler/Kconfig
```kconfig
#
# AI Butler — Board Sentinel (板载守望)
#

config AI_BUTLER
	bool "AI Butler / Board Sentinel"
	default n
	---help---
		GD32F470V-START 板载守望 Agent：仅用板载 LED/按键/串口 CLI，
		提供主动巡检 + LED 执行，不依赖外接传感器或 WiFi 模组。

if AI_BUTLER

config AI_BUTLER_PRIORITY
	int "Task priority"
	default 100

config AI_BUTLER_STACKSIZE
	int "Task stack size"
	default 4096

config AI_BUTLER_INSPECTION_INTERVAL
	int "Proactive inspection interval (seconds)"
	default 15
	---help---
		主动巡检周期。超时空闲会触发 LED 告警执行。

config AI_BUTLER_IDLE_ALERT_SEC
	int "Idle seconds before proactive LED alert"
	default 20

endif
```

## board/contest_board/Kconfig
```kconfig
#
# AI 管家项目 - GD32F470V-START 板级 Kconfig
# 基于 openvela + ai_agent 框架
#

if ARCH_BOARD_CUSTOM

choice
	prompt "Select Console wiring."
	default AI_BUTLER_CONSOLE_BOARD
	---help---
		Select where you will connect the console.

		Eval COM Port (USART0 PA9/PA10):

				GD32F470V-START
			USART0 GPIO
			-- ----- --------- -----
			RX    USART0_RX PA10
			TX    USART0_TX PA9
			-- ----- --------- -----

config AI_BUTLER_CONSOLE_BOARD
	bool "Eval COM Connector (USART0 PA9/PA10)"
	select GD32_USART0
	select USART0_SERIALDRIVER

config AI_BUTLER_CONSOLE_VIRTUAL
	bool "Virtual COM Port (USART3)"
	select GD32_USART3
	select USART3_SERIALDRIVER

config AI_BUTLER_CONSOLE_NONE
	bool "No Serial Console"

endchoice # "Select Console wiring"


choice
	prompt "GD32F470V MCU Crystal Selected"
	default AI_BUTLER_USE_HXTAL

config AI_BUTLER_USE_HXTAL
	bool "Use Hxtal as clock source"

config AI_BUTLER_USE_IRC16
	bool "Use IRC16M as clock source"

endchoice # MCU Crystal Selection

config AI_BUTLER_HXTAL_VALUE
	int "GD32F470V Start Board Hxtal Value"
	default 25000000
	depends on AI_BUTLER_USE_HXTAL
	---help---
		GD32F470V Start Board Hxtal Value, default is 25MHz.

choice
	prompt "GD32F470 MCU System Frequency"
	default AI_BUTLER_200MHZ

config AI_BUTLER_240MHZ
	bool "240 MHz"

config AI_BUTLER_200MHZ
	bool "200 MHz"

config AI_BUTLER_168MHZ
	bool "168 MHz"

endchoice # CPU Frequency

config BOARD_LOOPSPERMSEC
	int "Board loops-per-millisecond"
	default 13500  if AI_BUTLER_168MHZ
	default 16100  if AI_BUTLER_200MHZ
	default 19300  if AI_BUTLER_240MHZ

endif # ARCH_BOARD_CUSTOM
```

## board/contest_board/configs/nsh/defconfig
```kconfig
# AI 管家 MVP - 基于官方 gd32f470v_start NSH，先保证能启动串口
# 芯片/内存/Flash 对齐官方 START 板，避免 double-fault

CONFIG_ALLOW_MIT_COMPONENTS=y
CONFIG_ARCH="arm"
CONFIG_ARCH_ARM=y
CONFIG_ARCH_ARMV7M=y
CONFIG_ARCH_CHIP="gd32f4"
CONFIG_ARCH_CHIP_GD32F4=y
CONFIG_ARCH_CHIP_GD32F470IK=y
CONFIG_ARCH_BOARD_CUSTOM=y
CONFIG_ARCH_BOARD_CUSTOM_DIR="../vendor/openvela/boards/contest2026_381_board"
CONFIG_ARCH_BOARD_CUSTOM_DIR_RELPATH=y
CONFIG_ARCH_BOARD_CUSTOM_NAME="contest2026_381_board"
CONFIG_ARCH_INTERRUPTSTACK=2048
CONFIG_ARCH_STACKDUMP=y
CONFIG_BUILTIN=y
CONFIG_DEBUG_SYMBOLS=y
CONFIG_DEFAULT_TASK_STACKSIZE=4096

# Flash / Progmem（官方 START 必需）
CONFIG_GD32F4_FLASH_CONFIG_K=y
CONFIG_GD32F4_FMC=y
CONFIG_GD32F4_PROGMEM=y
CONFIG_GD32F4_DISABLE_IDLE_SLEEP_DURING_DEBUG=y

# 内存：字节数（原错误写成 256，会导致启动即 HardFault）
CONFIG_RAM_SIZE=114688
CONFIG_RAM_START=0x20000000
CONFIG_MM_REGIONS=1

# 串口控制台 USART0 PA9/PA10
CONFIG_USART0_SERIAL_CONSOLE=y
CONFIG_SERIALDRIVER=y
CONFIG_SYSLOG=y
CONFIG_SYSLOG_SERIAL_CONSOLE=y

# NSH
CONFIG_SYSTEM_NSH=y
CONFIG_INIT_ENTRYPOINT="nsh_main"
CONFIG_INIT_STACKSIZE=8192
CONFIG_IDLETHREAD_STACKSIZE=3072
CONFIG_NSH_ARCHINIT=y
CONFIG_NSH_BUILTIN_APPS=y
CONFIG_NSH_READLINE=y
CONFIG_NSH_FILEIOSIZE=512
CONFIG_LINE_MAX=64

# 文件系统（轻量）
CONFIG_FS_PROCFS=y
CONFIG_FS_TMPFS=y
CONFIG_FS_LITTLEFS=y
CONFIG_FS_LITTLEFS_PROGRAM_SIZE_FACTOR=1
CONFIG_MTD=y

# 调度 / 输出
CONFIG_SCHED_WAITPID=y
CONFIG_RR_INTERVAL=200
CONFIG_RAW_BINARY=y
CONFIG_INTELHEX_BINARY=y
CONFIG_TASK_NAME_SIZE=0

# 板级时钟（contest board Kconfig）
CONFIG_AI_BUTLER_200MHZ=y
CONFIG_AI_BUTLER_HXTAL_VALUE=25000000
CONFIG_AI_BUTLER_CONSOLE_BOARD=y
CONFIG_GD32F4_TCMEXCLUDE=y
CONFIG_AI_BUTLER=y
CONFIG_USERLED=y
CONFIG_USERLED_LOWER=y
CONFIG_ARCH_BUTTONS=y
CONFIG_INPUT_BUTTONS=y
CONFIG_INPUT_BUTTONS_LOWER=y
```
